## main/Kconfig.projbuild
```kconfig
menu "Configuração Dual Ethernet W5500"

choice NETIF_BACKEND
    prompt "Backend de rede"
    default NETIF_BACKEND_W5500
    help
        W5500 dual (produção): usa os dois módulos W5500 físicos (ESP32-S3),
        exatamente como validado em bancada.

        Wi-Fi STA (teste sem W5500): sobe UMA interface Wi-Fi e a usa tanto
        para o papel de ETH1 (MQTT) quanto ETH2 (proxy TCP). Serve pra testar
        a lógica de aplicação (mqtt_app, tcp_server_app, tcp_client_app,
        proxy_events) numa ESP32 qualquer, sem os módulos W5500 disponíveis.
        NÃO valida a separação real de tráfego entre interfaces — isso só
        existe com 2 NICs físicas — nem roda em ESP32-S3 vs ESP32 clássico
        (ambos suportam Wi-Fi STA normalmente).

config NETIF_BACKEND_W5500
    bool "Dual W5500 (produção)"

config NETIF_BACKEND_WIFI
    bool "Wi-Fi STA (teste de bancada sem W5500)"

endchoice # NETIF_BACKEND

if NETIF_BACKEND_WIFI

config TEST_WIFI_SSID
    string "SSID Wi-Fi (modo de teste)"
    default "changeme"
    help
        Rede Wi-Fi usada apenas no modo de teste (NETIF_BACKEND_WIFI), pra
        simular as interfaces ETH1/ETH2 numa ESP32 sem W5500.

config TEST_WIFI_PASSWORD
    string "Senha Wi-Fi (modo de teste)"
    default "changeme"

endif # NETIF_BACKEND_WIFI

config ETH_W5500_ENABLE
    bool "Habilitar Dual Ethernet W5500"
    default y
    depends on NETIF_BACKEND_W5500

if ETH_W5500_ENABLE

menu "Ethernet W5500 - Interface 1 (MQTT)"

config ETH1_W5500_SPI_HOST
    int "SPI Host para W5500_1"
    range 1 2
    default 1
    help
        Selecione o host SPI (1 para HSPI, 2 para VSPI) para o W5500 da Interface 1.

config ETH1_W5500_SPI_MISO
    int "GPIO MISO para W5500_1"
    default 12

config ETH1_W5500_SPI_MOSI
    int "GPIO MOSI para W5500_1"
    default 13

config ETH1_W5500_SPI_SCLK
    int "GPIO SCLK para W5500_1"
    default 14

config ETH1_W5500_SPI_CS
    int "GPIO CS para W5500_1"
    default 15

config ETH1_W5500_INT
    int "GPIO INT para W5500_1"
    default 36

config ETH1_W5500_RST
    int "GPIO RST para W5500_1"
    default 2

config ETH1_STATIC_IP_ADDR
    string "Endereço IP Estático para W5500_1"
    default "192.168.1.100"
    help
        Endereço IP estático para a Interface 1.

config ETH1_STATIC_GW_ADDR
    string "Endereço do Gateway para W5500_1"
    default "192.168.1.1"
    help
        Endereço do Gateway para a Interface 1.

config ETH1_STATIC_NETMASK_ADDR
    string "Máscara de Sub-rede para W5500_1"
    default "255.255.255.0"
    help
        Máscara de sub-rede para a Interface 1.

config ETH1_STATIC_DNS_ADDR
    string "Endereço DNS para W5500_1"
    default "8.8.8.8"
    help
        Endereço do servidor DNS para a Interface 1.

endmenu # Ethernet W5500 - Interface 1 (MQTT)

menu "Ethernet W5500 - Interface 2 (TCP Server)"

config ETH2_W5500_SPI_HOST
    int "SPI Host para W5500_2"
    range 1 2
    default 2
    help
        Selecione o host SPI (1 para HSPI, 2 para VSPI) para o W5500 da Interface 2.

config ETH2_W5500_SPI_MISO
    int "GPIO MISO para W5500_2"
    default 19

config ETH2_W5500_SPI_MOSI
    int "GPIO MOSI para W5500_2"
    default 23

config ETH2_W5500_SPI_SCLK
    int "GPIO SCLK para W5500_2"
    default 18

config ETH2_W5500_SPI_CS
    int "GPIO CS para W5500_2"
    default 5

config ETH2_W5500_INT
    int "GPIO INT para W5500_2"
    default 35

config ETH2_W5500_RST
    int "GPIO RST para W5500_2"
    default 4

config ETH2_STATIC_IP_ADDR
    string "Endereço IP Estático para W5500_2"
    default "192.168.2.100"
    help
        Endereço IP estático para a Interface 2.

config ETH2_STATIC_GW_ADDR
    string "Endereço do Gateway para W5500_2"
    default "192.168.2.1"
    help
        Endereço do Gateway para a Interface 2.

config ETH2_STATIC_NETMASK_ADDR
    string "Máscara de Sub-rede para W5500_2"
    default "255.255.255.0"
    help
        Máscara de sub-rede para a Interface 2.

config ETH2_STATIC_DNS_ADDR
    string "Endereço DNS para W5500_2"
    default "8.8.8.8"
    help
        Endereço do servidor DNS para a Interface 2.

endmenu # Ethernet W5500 - Interface 2 (TCP Server)

endif # ETH_W5500_ENABLE

# As configs abaixo (broker MQTT, porta TCP, host remoto, bind do proxy) são
# comuns aos dois backends (W5500 e Wi-Fi de teste) — por isso ficam FORA do
# bloco "if ETH_W5500_ENABLE": no modo de teste não existem CONFIG_ETH1_*/
# CONFIG_ETH2_* (GPIOs/IPs dos W5500), mas o app_main.c ainda usa
# CONFIG_MQTT_BROKER_URI, CONFIG_TCP_SERVER_PORT etc. normalmente.

config MQTT_BROKER_URI
    string "URI do Broker MQTT"
    default "mqtt://broker.hivemq.com:1883"
    help
        URI completa do broker MQTT (ex: mqtt://broker.hivemq.com:1883).

config TCP_SERVER_PORT
    int "Porta do Servidor TCP"
    default 3333
    help
        Porta na qual o servidor TCP irá escutar por conexões.

menu "Configuração Socket Doppler (TCP Client)"
config REMOTE_HOST_IP
    string "Endereço IP do Host Remoto"
    default "192.168.1.101"
    help
        Endereço IP do host remoto ao qual o cliente TCP irá se conectar.

config REMOTE_HOST_PORT
    int "Porta do Host Remoto"
    default 50000
    help
        Porta do host remoto ao qual o cliente TCP irá se conectar.
endmenu # Configuração Socket Doppler (TCP Client)

config TCP_PROXY_BIND_ETH_IDX
    int "Indice da interface Ethernet para fixar o proxy TCP"
    range -1 1
    default 1
    help
        Indice no array eth_netifs[] (definido em main/app_main.c) da
        interface Ethernet em que o proxy TCP (servidor + cliente) deve
        ser fixado via bind(), tanto para aceitar conexoes quanto para
        a conexao de saida ao host remoto.

        0  = ETH1 (W5500 #1 - normalmente reservado para o MQTT)
        1  = ETH2 (W5500 #2 - normalmente reservado ao proxy TCP)
        -1 = Automatico: nao fixa em nenhuma interface especifica,
             deixa a tabela de rotas do lwIP escolher com base no IP
             de destino/origem (comportamento antigo). Sujeito a
             vazar trafego do proxy para a interface "errada"
             dependendo da sub-rede do host remoto e do route_prio
             configurado em cada eth_w5500_config_t.

endmenu # Configuração Dual Ethernet W5500
```
